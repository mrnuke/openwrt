## target/linux/realtek/files-5.10/drivers/leds/realtek/Kconfig
```kconfig
# SPDX-License-Identifier: GPL-2.0-only
menuconfig LEDS_RTL
	bool "Realtek LED support"
	help
	  Say Y to enable support for LED peripherals found on Realtek switch
	  SoCs.

if LEDS_RTL

config LEDS_RTL_SWITCHCORE_PORT
	bool "Realtek switch SoC port LED support"
	default MFD_REALTEK_SWITCHCORE
	depends on LEDS_CLASS
	depends on MFD_REALTEK_SWITCHCORE || COMPILE_TEST
	select MFD_SYSCON
	help
	  This option enables support for Realtek switch SoC port LEDs.

config LEDS_RTL_SWITCHCORE_SYSTEM
	bool "Realtek switch SoC system LED support"
	default MFD_REALTEK_SWITCHCORE
	depends on LEDS_CLASS
	depends on MFD_REALTEK_SWITCHCORE || COMPILE_TEST
	select MFD_SYSCON
	help
	  This option enables support for Realtek switch SoC system LEDs.

endif # LED_RTL
```
